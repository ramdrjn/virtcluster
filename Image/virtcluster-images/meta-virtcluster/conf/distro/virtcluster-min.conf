## Image/virtcluster-images/meta-virtcluster/conf/distro/virtcluster-min.conf
```bitbake
require conf/distro/poky-tiny.conf

DISTRO = "virtcluster"
DISTRO_NAME = "virtcluster-os"
DISTRO_VERSION = "1.0.0"

TCLIBC = "eglibc"

DISTRO_FEATURES = " \
                  ipv4 \
                  pci \
                  usbhost \
                  ${DISTRO_FEATURES_LIBC} \
                  "

DISTRO_EXTRA_RDEPENDS = ""
DISTRO_EXTRA_RRECOMMENDS = ""
```

## Image/virtcluster-images/meta-virtcluster/conf/layer.conf
```bitbake
# We have a conf and classes directory, add to BBPATH
BBPATH .= ":${LAYERDIR}"

# We have recipes-* directories, add to BBFILES
BBFILES += "${LAYERDIR}/recipes-*/*/*.bb \
	${LAYERDIR}/recipes-*/*/*.bbappend"

BBFILE_COLLECTIONS += "virtcluster"
BBFILE_PATTERN_virtcluster = "^${LAYERDIR}/"
BBFILE_PRIORITY_virtcluster = "6"
```

## Image/virtcluster-images/meta-x86vm/conf/machine/x86vm-min.conf
```bitbake
#@TYPE: Machine
#@NAME: x86vm-min

#@DESCRIPTION: Machine configuration for x86vm-min systems


PREFERRED_PROVIDER_virtual/kernel ?= "linux-yocto"
PREFERRED_VERSION_linux-yocto ?= "3.8%"

PREFERRED_PROVIDER_virtual/xserver ?= "xserver-xorg"
PREFERRED_PROVIDER_virtual/libgl ?= "mesa"
PREFERRED_PROVIDER_virtual/libgles1 ?= "mesa"
PREFERRED_PROVIDER_virtual/libgles2 ?= "mesa"

require conf/machine/include/qemu.inc
require conf/machine/include/tune-i586.inc

MACHINE_FEATURES = "acpi apm pci usbhost x86"
KERNEL_IMAGETYPE = "bzImage"
SERIAL_CONSOLE = "115200 ttyS0"
XSERVER = "xserver-xorg \
           mesa-driver-swrast \
           xf86-input-vmmouse \
           xf86-input-keyboard \
           xf86-input-evdev \
           xf86-video-vmware"
```

## meta-virtcluster/conf/distro/virtcluster-os.conf
```bitbake
DISTRO_NAME = "virtcluster-os"
DISTRO_VERSION = "1.0.0"

TCLIBC = "eglibc"

DISTRO_FEATURES = "ipv4"

DISTRO_EXTRA_RDEPENDS = ""
DISTRO_EXTRA_RRECOMMENDS = ""
```

## meta-virtcluster/conf/distro/virtcluster.conf
```bitbake
#Use distro feature defined in poky distro.
require conf/distro/poky.conf

DISTRO = "virtcluster"
DISTRO_NAME = "virtcluster-os"
DISTRO_VERSION = "1.0.0"
```

## meta-x86vm/conf/layer.conf
```bitbake
# We have a conf and classes directory, add to BBPATH
BBPATH .= ":${LAYERDIR}"

# We have a recipes-* directories, add to BBFILES
BBFILES += "${LAYERDIR}/recipes-*/*/*.bb \
	${LAYERDIR}/recipes-*/*/*.bbappend"

BBFILE_COLLECTIONS += "x86vm"
BBFILE_PATTERN_x86vm = "^${LAYERDIR}/"
BBFILE_PRIORITY_x86vm = "6"
```
